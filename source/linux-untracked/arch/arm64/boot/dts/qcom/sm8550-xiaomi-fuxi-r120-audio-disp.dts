// SPDX-License-Identifier: BSD-3-Clause
/*
 * Xiaomi 13: audio-disp with the panel at 120 Hz. Vendor timing@1 (120 Hz)
 * shares porches and the 1.1 GHz lane rate with timing@0, so only the panel
 * refresh parameter changes.
 */

#include "sm8550-xiaomi-fuxi-audio-disp.dts"

/ {
	chosen {
		bootargs = "loglevel=7 log_buf_len=2M panic=0 clk_ignore_unused pd_ignore_unused regulator_ignore_unused arm-smmu.disable_bypass=0 cpuidle.off=1 fbcon=font:TER16x32 console=tty0 fuxi.fb=0xB8000000,1080,2400,1080,32 rdinit=/init g_cdc.idVendor=0x0525 g_cdc.idProduct=0xa4a7 g_cdc.dev_addr=02:f0:c5:13:00:02 g_cdc.host_addr=02:f0:c5:13:00:01 panel_xiaomi_fuxi.refresh=120";
	};
};
