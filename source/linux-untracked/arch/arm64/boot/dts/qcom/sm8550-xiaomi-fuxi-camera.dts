// SPDX-License-Identifier: BSD-3-Clause
/* Xiaomi 13 (fuxi)：相机 bring-up 变体（内容见 sm8550-xiaomi-fuxi-camera.dtsi） */

#include "sm8550-xiaomi-fuxi-min.dts"
#include <dt-bindings/clock/qcom,sm8550-camcc.h>
#include "sm8550-xiaomi-fuxi-camera.dtsi"
