## source/linux-untracked/Documentation/devicetree/bindings/display/panel/xiaomi,fuxi-m3-38-0c-0a.yaml
```yaml
# SPDX-License-Identifier: (GPL-2.0-only OR BSD-2-Clause)
%YAML 1.2
---
$id: http://devicetree.org/schemas/display/panel/xiaomi,fuxi-m3-38-0c-0a.yaml#
$schema: http://devicetree.org/meta-schemas/core.yaml#

title: Xiaomi 13 (fuxi) Samsung M3 AMOLED DSI Panel

maintainers:
  - Neil Armstrong <neil.armstrong@linaro.org>

description:
  The Xiaomi 13 uses a 1080x2400 Samsung AMOLED panel connected over a
  four-lane MIPI DSI link. The panel operates in command mode and uses DSC.

allOf:
  - $ref: panel-common.yaml#

properties:
  compatible:
    const: xiaomi,fuxi-m3-38-0c-0a

  reg:
    maxItems: 1

  vddio-supply:
    description: 1.8 V panel I/O supply

  vddd-supply:
    description: 1.5 V panel core supply

  vci-supply:
    description: 3.0 V panel analog supply

  port: true
  reset-gpios: true

required:
  - compatible
  - reg
  - vddio-supply
  - vddd-supply
  - vci-supply
  - reset-gpios
  - port

unevaluatedProperties: false

examples:
  - |
    #include <dt-bindings/gpio/gpio.h>

    dsi {
        #address-cells = <1>;
        #size-cells = <0>;

        panel@0 {
            compatible = "xiaomi,fuxi-m3-38-0c-0a";
            reg = <0>;

            vddio-supply = <&panel_vddio_1p8>;
            vddd-supply = <&panel_vddd_1p5>;
            vci-supply = <&panel_vci_3p0>;
            reset-gpios = <&tlmm 133 GPIO_ACTIVE_LOW>;

            port {
                panel_in: endpoint {
                    remote-endpoint = <&mdss_dsi0_out>;
                };
            };
        };
    };

...
```

## source/linux-untracked/Documentation/devicetree/bindings/input/touchscreen/st,ftm5.yaml
```yaml
# SPDX-License-Identifier: (GPL-2.0-only OR BSD-2-Clause)
%YAML 1.2
---
$id: http://devicetree.org/schemas/input/touchscreen/st,ftm5.yaml#
$schema: http://devicetree.org/meta-schemas/core.yaml#

title: STMicroelectronics FingerTip FTM5 touchscreen controller

maintainers:
  - Dmitry Torokhov <dmitry.torokhov@gmail.com>

description: ST FTM5 touchscreen controller connected over SPI.

allOf:
  - $ref: touchscreen.yaml#
  - $ref: /schemas/spi/spi-peripheral-props.yaml#

properties:
  compatible:
    const: st,ftm5

  reg:
    maxItems: 1

  interrupts:
    maxItems: 1

  reset-gpios:
    maxItems: 1

  vdd-supply: true

  avdd-supply: true

  spi-max-frequency: true

required:
  - compatible
  - reg
  - reset-gpios
  - vdd-supply
  - avdd-supply
  - spi-max-frequency
  - touchscreen-size-x
  - touchscreen-size-y

oneOf:
  - required:
      - interrupts
  - required:
      - interrupts-extended

unevaluatedProperties: false

examples:
  - |
    #include <dt-bindings/gpio/gpio.h>
    #include <dt-bindings/interrupt-controller/irq.h>

    spi {
      #address-cells = <1>;
      #size-cells = <0>;

      touchscreen@0 {
        compatible = "st,ftm5";
        reg = <0>;
        spi-max-frequency = <12000000>;
        interrupts-extended = <&tlmm 25 IRQ_TYPE_LEVEL_LOW>;
        reset-gpios = <&tlmm 24 GPIO_ACTIVE_LOW>;
        vdd-supply = <&vdd>;
        avdd-supply = <&avdd>;
        touchscreen-size-x = <10800>;
        touchscreen-size-y = <24000>;
      };
    };

...
```
